&cirque_rh_listener {
    status = "okay";
    device = <&glidepoint>;
    input-processors = <&zip_xy_scaler 3 1>,
                       <&zip_temp_layer 3 200>;
};

&cirque_lh_listener {
    status = "okay";
    device = <&cirque_split>;
    input-processors = <&zip_xy_scaler 8 15>,
                       <&zip_xy_to_scroll_mapper>,
                       <&zip_temp_layer 3 200>;
};
