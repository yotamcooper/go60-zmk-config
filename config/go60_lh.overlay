#include <behaviors/input_processors.dtsi>

&cirque_lh_listener {
    input-processors = <&zip_xy_scaler 8 15>,
                       <&zip_xy_to_scroll_mapper>,
                       <&zip_temp_layer 3 200>;
};

&cirque_rh_listener {
    input-processors = <&zip_xy_scaler 3 1>,
                       <&zip_temp_layer 3 200>;
};
